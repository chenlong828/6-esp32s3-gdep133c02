## firmware/e6_epd/sdkconfig.defaults
```kconfig
# GDEB0709E01 ESP32-S3
# ESP-IDF 5.4.x

CONFIG_PARTITION_TABLE_CUSTOM=y
CONFIG_PARTITION_TABLE_CUSTOM_FILENAME="partitions.csv"
CONFIG_PARTITION_TABLE_OFFSET=0x8000

CONFIG_SPI_MASTER_IN_IRAM=y
CONFIG_COMPILER_OPTIMIZATION_SIZE=y

# 本板：ESP32-S3R8（16MB Flash + 8MB Octal PSRAM），覆盖厂家示例的默认值
CONFIG_ESPTOOLPY_FLASHSIZE_16MB=y
CONFIG_ESPTOOLPY_FLASHSIZE="16MB"
CONFIG_ESPTOOLPY_FLASHMODE_QIO=y
CONFIG_ESPTOOLPY_FLASHFREQ_80M=y
CONFIG_SPIRAM=y
CONFIG_SPIRAM_MODE_OCT=y
CONFIG_SPIRAM_SPEED_80M=y
CONFIG_SPIRAM_USE_MALLOC=y
```
